## build/Kconfig/Kconfig.shield
```kconfig
osource "d:/devlop/zephyerproject/zephyr_2.4.1/nrf52840dk_fc41d_uart/boards/shields/*/Kconfig.shield"
osource "C:/ncs/v2.4.1/nrf/boards/shields/*/Kconfig.shield"
```
